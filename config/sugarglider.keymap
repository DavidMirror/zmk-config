/* source keypos definitions */
#include "../zmk-nodefree-config/keypos_def/keypos_sugarglider.h"

/* map Sugar Glider's extra keys */
#define X_LT    &kp ESC
#define X_MT    &kp N2            //Top mini switch
#define X_RT    &kp BACKSLASH

#define X_LM    &kp Q
#define X_MM    &kp N2     &kp N2     //Bottom 2 mini switches 
#define X_RM    &kp BSPC 

#define X_LB    &kp N1
#define X_MB    &kp N2            //unknown key (touchpad touch?)
#define X_RB    &kp N3

#define X_LH    &kp C_MUTE &lt MEDIA ESC     //Left Encoder key, left most thumb key
#define X_MH    &kp N2     &kp N2     &kp N2//&mkp LCLK  &mkp MCLK  &mkp RCLK       //Mouse keys 
#define X_RH    &bs_del    &kp C_PP           // Right-most thumb key,  Right ecoder key

/* activate bluetooth */
// #define CONFIG_WIRELESS 1

/* source the main keymap */
#include "base.keymap"

/* use 5-column layout for Zen */
// { chosen { zmk,matrix_transform = &five_column_transform; }; };