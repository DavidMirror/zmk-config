/* source keypos definitions */
#include "../zmk-nodefree-config/keypos_def/keypos_reviung41.h"

/* map extra keys */
#define X_MH  &num_word  // thumb row, left

/* activate bluetooth */
/* #define CONFIG_WIRELESS 1 */

/* source the main keymap */
#include "base.keymap"

/* use 5-column layout for  */
// { chosen { zmk,matrix_transform = &five_column_transform; }; };