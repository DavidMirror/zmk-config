## config/boards/Kconfig.shield
```kconfig
# Copyright (c) 2022 The ZMK Contributors
# SPDX-License-Identifier: MIT

config SHIELD_Drac_LEFT
    def_bool $(shields_list_contains,drac_left)

config SHIELD_Drac_RIGHT
    def_bool $(shields_list_contains,drac_right)
```

## config/boards/shields/dactyl/Kconfig.defconfig
```kconfig
# Copyright (c) 2020 The ZMK Contributors
# SPDX-License-Identifier: MIT

if SHIELD_Dactyl_LEFT

config ZMK_KEYBOARD_NAME
    default "dactyl"

config ZMK_SPLIT_ROLE_CENTRAL
    default y

endif

if SHIELD_Dactyl_LEFT || SHIELD_Dactyl_RIGHT

config ZMK_SPLIT
    default y

endif
```

## config/boards/shields/dactyl/Kconfig.shield
```kconfig
# Copyright (c) 2022 The ZMK Contributors
# SPDX-License-Identifier: MIT

config SHIELD_Dactyl_LEFT
    def_bool $(shields_list_contains,dactyl_left)

config SHIELD_Dactyl_RIGHT
    def_bool $(shields_list_contains,dactyl_right)
```

## config/boards/shields/osprette_nate/Kconfig.defconfig
```kconfig
# Copyright (c) 2021 The ZMK Contributors
# SPDX-License-Identifier: MIT

if SHIELD_OSPRETTE_NATE

config ZMK_KEYBOARD_NAME
    default "Osprette_Nate"

endif
```

## config/boards/shields/osprette_nate/Kconfig.shield
```kconfig
# Copyright (c) 2021 The ZMK Contributors
# SPDX-License-Identifier: MIT

config SHIELD_OSPRETTE_NATE
    def_bool $(shields_list_contains,osprette_nate)
```

## config/boards/shields/reviung34_nate/Kconfig.defconfig
```kconfig
# Copyright (c) 2023 The ZMK Contributors
# SPDX-License-Identifier: MIT

if SHIELD_REVIUNG34_NATE

config ZMK_KEYBOARD_NAME
    default "REVIUNG34_NATE"

endif
```

## config/boards/shields/reviung34_nate/Kconfig.shield
```kconfig
# Copyright (c) 2023 The ZMK Contributors
# SPDX-License-Identifier: MIT

config SHIELD_REVIUNG34_NATE
    def_bool $(shields_list_contains,reviung34_nate)
```

## config/west.yml
```yaml
manifest:
  remotes:
    - name: zmkfirmware
      url-base: https://github.com/zmkfirmware
    - name: urob
      url-base: https://github.com/urob
    - name: mechwild
      url-base: https://github.com/mechwild
    - name: lesshonor
      url-base: https://github.com/lesshonor
    - name: petejohanson
      url-base: https://github.com/petejohanson
  projects:
    - name: mechwild-zmk-keyboards
      #remote: mechwild
      remote: lesshonor  # Eventually, you'll want to swap this out with mechwild.
      revision: cirque
      clone-depth: 1
    - name: zmk
      remote: urob
      revision: pull/2027/merge
      import: app/west.yml
    - name: cirque-input-module
      remote: petejohanson
      revision: main
      clone-depth: 1
  self:
    path: config
```
