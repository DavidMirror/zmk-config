/* source keypos definitions */
#include "../zmk-nodefree-config/keypos_def/keypos_36keys.h"

/* map Draculad's extra keys */
#define X_LH  &lt MEDIA ESC  // thumb row, left
#define X_RH  &lt FUN DELETE      // thumb row, right

/* activate bluetooth */
#define CONFIG_WIRELESS 1

/* source the main keymap */
#include "base.keymap"

/* use 5-column layout for Zen */
// { chosen { zmk,matrix_transform = &five_column_transform; }; };